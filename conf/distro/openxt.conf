## conf/distro/openxt.conf
```bitbake
DISTRO_NAME = "OpenXT"
DISTRO_VERSION = "1.0alpha1"
DISTRO_FEATURES = "alsa ext2 largefile usbhost wifi xattr pci x11 ipv4 ipv6 ${DISTRO_FEATURES_LIBC} multiarch pam selinux"

XENCLIENT_BUILD = "openxt-dev--master"
XENCLIENT_BUILD_DATE = "18:22:00 09/25/14"
XENCLIENT_BUILD_BRANCH = "master"
XENCLIENT_VERSION = "4.0.0"
XENCLIENT_RELEASE = "4.0.0"
XENCLIENT_TOOLS = "14.0.0.0"

PREFERRED_PROVIDER_virtual/java-initial = "cacao-initial"

PREFERRED_PROVIDER_virtual/java-native = "jamvm-native"
PREFERRED_PROVIDER_virtual/javac-native = "ecj-bootstrap-native"

PREFERRED_PROVIDER_alsa-utils-alsaconf = "alsa-utils"
PREFERRED_PROVIDER_virtual/java-initial = "jamvm-initial"
PREFERRED_PROVIDER_sysvinit-inittab = "sysvinit"

PREFERRED_VERSION_busybox = "1.22.1"
PREFERRED_VERSION_consolekit = "0.4.6"
PREFERRED_VERSION_dbus = "1.6.18"
PREFERRED_VERSION_ghc_native = "6.12.1"
PREFERRED_VERSION_icedtea6-native = "1.8.11"
PREFERRED_VERSION_libsoup-2.4 = "2.45.3"
PREFERRED_VERSION_libtirpc = "0.2.2"
PREFERRED_VERSION_kmod = "16+gitAUTOINC+36c4bb928a"
PREFERRED_VERSION_ocaml-cross = "3.12.1"
PREFERRED_VERSION_openjdk-6-jre = "6b27-1.12.5"
PREFERRED_VERSION_openssh = "6.1p1"
PREFERRED_VERSION_tpm-tools = "1.3.1"
PREFERRED_VERSION_trousers = "0.3.2-1"


# Keep GTK+3 and xfce 4.10 out for now
PREFERRED_VERSION_evo = "0.6.2"
PREFERRED_VERSION_gtk+ = "2.24.22"
PREFERRED_VERSION_gtk-xfce-engine = "2.9.0"
PREFERRED_VERSION_libxfce4ui = "4.8.1"
PREFERRED_VERSION_libxfce4util = "4.8.2"
PREFERRED_VERSION_midori = "0.1.8"
PREFERRED_VERSION_xfce4 = "4.8.3"
PREFERRED_VERSION_xfce4-panel = "4.8.6"
PREFERRED_VERSION_xfce4-settings = "4.8.3"
PREFERRED_VERSION_xfconf = "4.8.0"
PREFERRED_VERSION_webkit-gtk = "1.8.3"
```

## conf/layer.conf
```bitbake
# We have a conf and classes directory, append to BBPATH
BBPATH .= ":${LAYERDIR}"

# meta-selinux incorrectly enables selinux for util-linux so masking
BBMASK = "meta-selinux/recipes-core/util-linux/"


# We have a recipes directory, add to BBFILES
BBFILES += "${LAYERDIR}/recipes*/*/*.bb ${LAYERDIR}/recipes*/*/*.bbappend"
BBFILES += "${LAYERDIR}/recipes*/*/*/*.bb ${LAYERDIR}/recipes*/*/*/*.bbappend"

BBFILE_COLLECTIONS += "openxt"
BBFILE_PATTERN_openxt := "^${LAYERDIR}/"
BBFILE_PRIORITY_openxt = "9"

STAGING_IDLDIR = "${STAGING_DATADIR}/idl"

OPENXT_MIRROR="http://openxt.xci-test.com/mirror"
OPENXT_GIT_MIRROR="git://github.com/OpenXT"
XENCLIENT_BRANCH="master"
OPENXT_TAG="master"

# xen version and source archive
XEN_VERSION="4.3.2"
XEN_SRC_URI="http://bits.xensource.com/oss-xen/release/4.3.2/xen-4.3.2.tar.gz"
XEN_SRC_MD5SUM="83e0e13678383e4fbcaa69ce6064b187"
XEN_SRC_SHA256SUM="17611d95f955302560ff72d97c08933b4e62bc2e8ffb71400fc54e388746ff69"

# Proprietary licenses we can ship
LICENSE_FLAGS_WHITELIST = "commercial_broadcom-wifi"
LICENSE_FLAGS_WHITELIST += "commercial_microcode-ctl"

# disable --as-needed flag for the recipes 
ASNEEDED_pn-acpi-helper = ""
ASNEEDED_pn-pci-dm-helper = ""
ASNEEDED_pn-audio-helper = ""
ASNEEDED_pn-atapi-pt-helper = ""
ASNEEDED_pn-libxcxenstore = ""
ASNEEDED_pn-libsurfman = ""
ASNEEDED_pn-libdmbus = ""
ASNEEDED_pn-vbetool-xc = ""
ASNEEDED_pn-qemu-wrappers = ""
ASNEEDED_pn-pmutil = ""
ASNEEDED_pn-xcpmd = ""
ASNEEDED_pn-tboot = ""
ASNEEDED_pn-selinux-load = ""
ASNEEDED_pn-svirt-interpose = ""
ASNEEDED_pn-xenclient-input-daemon = ""
ASNEEDED_pn-bootage = ""
ASNEEDED_pn-surfman = ""
ASNEEDED_pn-audio-daemon = ""
ASNEEDED_pn-xenclient-sha1sum = ""
ASNEEDED_pn-midori = ""
ASNEEDED_pn-busybox-static = ""
ASNEEDED_pn-dm-wrapper = ""
ASNEEDED_pn-dm-wrapper-static = ""
ASNEEDED_pn-xenclient-dbusbouncer = ""
ASNEEDED_pn-sysvinit = ""
#ASNEEDED_pn-xdotool = ""

# CFLAGS/LDFLAGS hacks
LDFLAGS_pn-xdotool += "-lX11"
LDFLAGS_pn-midori += "-ljavascriptcoregtk-1.0"

LDFLAGS_pn-compleat += "-pthread"
CFLAGS_pn-compleat += "-pthread"

LDFLAGS_pn-xenclient-rpcgen += "-pthread"
CFLAGS_pn-xenclient-rpcgen += "-pthread"

LDFLAGS_pn-xenclient-input-daemon += "-lm -lcrypto"

LDFLAGS_pn-devilspie += "-lX11"

CFLAGS_pn-networkmanager-applet += "-Wno-error=unused-but-set-variable"

# make hacks
PARALLEL_MAKE_pn-libxclogging = "-j 1"
PARALLEL_MAKE_pn-gnumail = "-j 1"
PARALLEL_MAKE_pn-gnumail-native = "-j 1"
PARALLEL_MAKE_pn-shared-mime-info = "-j 1"
PARALLEL_MAKE_pn-shared-mime-info-native = "-j 1"
```
